## Kconfig
```kconfig
# SPDX-License-Identifier: ISC

menuconfig TINYGRID
	bool "tinygrid: a Thread child that never routes"
	depends on HAS_HW_NRF_RADIO_IEEE802154 && !OPENTHREAD
	select SETTINGS
	help
	  A Thread end device on the nRF 802.15.4 radio: attach as a child,
	  keep the link, configure addresses from the network data, carry UDP
	  and register services over SRP. No OpenThread, no network stack.

if TINYGRID

choice TINYGRID_RADIO
	prompt "Radio driver"
	default TINYGRID_RADIO_NRF_802154

config TINYGRID_RADIO_NRF_802154
	bool "Nordic's nRF 802.15.4 driver"
	select NRF_802154_RADIO_DRIVER

config TINYGRID_RADIO_OWN
	bool "tinygrid's own, in the Bluetooth controller's gaps [EXPERIMENTAL]"
	depends on SOC_SERIES_NRF52
	select EXPERIMENTAL
	select NRFX_GPPI
	# Not "depends on MPSL": MPSL selects a Nordic driver option, so that
	# closes a dependency loop through this choice.
	select MPSL if !BT_LL_SW_SPLIT
	select BT_CTLR_USER_EXT if BT_LL_SW_SPLIT
	help
	  Drives the RADIO directly in slots the Bluetooth controller lends,
	  Bluetooth first, instead of linking Nordic's driver. Next to
	  Nordic's SoftDevice Controller the slots are MPSL timeslots, one
	  session (CONFIG_MPSL_TIMESLOT_SESSION_COUNT=1); with the Zephyr
	  controller they are events of its own scheduler.

endchoice

config TINYGRID_POLL_MS
	int "Sleepy poll period (ms); 0 for a receiver that is always on"
	default 0
	help
	  0 attaches as a minimal end device (MED) whose receiver never
	  sleeps. Anything else attaches as a sleepy end device (SED) that
	  polls its parent this often.

config TINYGRID_DNS
	bool "DNS-SD resolver (tg_dns_resolve)"
	default y if ULTRAWIDELOCK_MATTER_CLIENT
	help
	  Resolving another node's service instance, which only a Matter
	  client does. About 1 KB of flash.

config TINYGRID_MULTICAST
	bool "Realm-local multicast (ff03::/16) with MPL"
	default y if ULTRAWIDELOCK_MATTER
	help
	  Sending to and hearing from the realm-local groups, as
	  ultrawidelock's sealed link does. Without it only MLE uses
	  multicast, and link-local only.

config TINYGRID_CHILD_TIMEOUT
	int "Child timeout (s)"
	default 240
	help
	  How long the parent keeps this child without hearing from it. The
	  child sends a keep-alive 4 s before it runs out.

config TINYGRID_SRP_LEASE_S
	int "SRP lease (s) of a service that names none"
	default 7200
	help
	  The lease an SRP update asks for a service whose lease_s is 0,
	  and for a host with no service. 7,200 s is OpenThread's client
	  default (OPENTHREAD_CONFIG_SRP_CLIENT_DEFAULT_LEASE).

config TINYGRID_TX_POWER
	int "Transmit power (dBm)"
	default 0

config TINYGRID_STACK_SIZE
	int "Stack of the tinygrid thread"
	default TINYTALK_THREAD_RX_STACK_SIZE if TINYTALK
	default 4096
	help
	  Matter's datagram handler runs on it. With tinytalk the size is
	  CONFIG_TINYTALK_THREAD_RX_STACK_SIZE, and the adapter fails the
	  build below it.

config TINYGRID_THREAD_PRIORITY
	int "Priority of the tinygrid thread"
	default 8

config TINYGRID_MATTER
	bool "matter_thread.h on tinygrid, for tinytalk or ultrawidelock"
	default y
	depends on (TINYTALK && !TINYTALK_THREAD) || ULTRAWIDELOCK_MATTER
	select TINYTALK_HAS_THREAD if TINYTALK

config TINYGRID_MATTER_COMM_LEASE_S
	int "SRP lease (s) of the commissionable record"
	default 120
	depends on TINYGRID_MATTER
	help
	  The _matterc._udp record's lease, shorter than the operational
	  records' CONFIG_TINYGRID_SRP_LEASE_S: a node that loses power with
	  a window open leaves a record Apple Home dials over Thread instead
	  of using BLE. As tinytalk's SRP_COMM_LEASE_S
	  (ports/zephyr/thread/matter_thread_port.c).

endif

if BT_LL_SW_SPLIT

# The Zephyr controller lends the radio through one ticker node of tinygrid's.
config BT_CTLR_USER_TICKER_ID_RANGE
	default 1 if TINYGRID_RADIO_OWN

endif # BT_LL_SW_SPLIT
```
